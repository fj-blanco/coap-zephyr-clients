## CMakeLists.txt
```
#
# mbedtls/CMakeLists.txt
#
# Copyright (C) 2024-2025 Javier Blanco-Romero @fj-blanco (UC3M, QURSA project)
#
# CMake configuration for CoAP client
#

cmake_minimum_required(VERSION 3.20.0)

find_package(Zephyr REQUIRED HINTS $ENV{ZEPHYR_BASE})
project(libcoap_mbedtls_client)

# Create alias for libcoap (ALIAS targets don't propagate from add_subdirectory)
if(CONFIG_MBEDTLS AND TARGET mbedTLS AND NOT TARGET MbedTLS::mbedtls)
    add_library(MbedTLS::mbedtls ALIAS mbedTLS)
endif()

# CoAP server configuration
set(COAP_SERVER_IP_VALUE $ENV{COAP_IP})
set(COAP_SERVER_PATH_VALUE $ENV{COAP_PATH})
set(COAP_SERVER_PORT_VALUE $ENV{COAP_PORT})

if(DEFINED COAP_IP)
    set(COAP_SERVER_IP_VALUE ${COAP_IP})
endif()

if(DEFINED COAP_PATH)
    set(COAP_SERVER_PATH_VALUE ${COAP_PATH})
endif()

if(DEFINED COAP_PORT)
    set(COAP_SERVER_PORT_VALUE ${COAP_PORT})
endif()

if(NOT COAP_SERVER_IP_VALUE)
    set(COAP_SERVER_IP_VALUE "134.102.218.18")
endif()

if(NOT COAP_SERVER_PATH_VALUE)
    set(COAP_SERVER_PATH_VALUE "/hello")
endif()

if(NOT COAP_SERVER_PORT_VALUE)
    set(COAP_SERVER_PORT_VALUE "5683")
endif()

# DTLS configuration
set(USE_DTLS_VALUE $ENV{USE_DTLS})
if(DEFINED USE_DTLS)
    set(USE_DTLS_VALUE ${USE_DTLS})
endif()

# Handle WiFi configuration
set(WIFI_SSID_VALUE $ENV{WIFI_SSID})
set(WIFI_PASS_VALUE $ENV{WIFI_PASS})

if(DEFINED WIFI_SSID)
    set(WIFI_SSID_VALUE ${WIFI_SSID})
endif()

if(DEFINED WIFI_PASS)
    set(WIFI_PASS_VALUE ${WIFI_PASS})
endif()

if(NOT WIFI_SSID_VALUE)
    set(WIFI_SSID_VALUE "WIFI_SSID_NOT_SET")
endif()

if(NOT WIFI_PASS_VALUE)
    set(WIFI_PASS_VALUE "WIFI_PASS_NOT_SET")
endif()

zephyr_include_directories(include)

target_include_directories(app PRIVATE ${CMAKE_CURRENT_SOURCE_DIR}/include)
target_sources(app PRIVATE src/main.c src/wifi.c)

target_compile_definitions(app PRIVATE
    COAP_SERVER_IP="${COAP_SERVER_IP_VALUE}"
    COAP_SERVER_PATH="${COAP_SERVER_PATH_VALUE}"
    COAP_SERVER_PORT=${COAP_SERVER_PORT_VALUE}
    WIFI_SSID="${WIFI_SSID_VALUE}"
    WIFI_PASS="${WIFI_PASS_VALUE}"
)

# Add DTLS support if enabled
if(USE_DTLS_VALUE)
    target_compile_definitions(app PRIVATE USE_DTLS=1)
    message(STATUS "DTLS mode: ENABLED")
else()
    message(STATUS "DTLS mode: DISABLED")
endif()

message(STATUS "...............................................")
message(STATUS "CoAP Server: ${COAP_SERVER_IP_VALUE}${COAP_SERVER_PATH_VALUE}:${COAP_SERVER_PORT_VALUE}")
message(STATUS "WiFi Network: ${WIFI_SSID_VALUE}")
message(STATUS "...............................................")
```

## Kconfig
```
# Copyright (c) 2023 Synopsys.
#
# SPDX-License-Identifier: Apache-2.0

mainmenu "Application configuration"

config SAMPLE_DO_OUTPUT
	bool "Do print from the main thread which can be checked"

source "Kconfig.zephyr"
```

## sample.yaml
```
common:
sample:
  description: ESP32 libcoap minimal client
  name: Zephyr libcoap mininmal client
```

## west.yml
```
manifest:
  defaults:
    remote: zephyrproject
  remotes:
    - name: zephyrproject
      url-base: https://github.com/zephyrproject-rtos
    - name: libcoap-official
      url-base: https://github.com/obgm
  projects:
    - name: zephyr
      remote: zephyrproject
      repo-path: zephyr
      revision: v4.3.0
      path: zephyr
      import:
        name-allowlist:
          - hal_espressif  # ESP32 HAL
          - mbedtls        # TLS/crypto library
          - picolibc       # C library
    - name: libcoap
      remote: libcoap-official
      repo-path: libcoap
      revision: 0bf6a2d7  # v4.3.5-187 - pinned for reproducible builds
      path: modules/lib/libcoap
  self:
    path: .
```

## prj.conf
```kconfig
# ESP32 libcoap mbedTLS Configuration

# Core System
CONFIG_NEWLIB_LIBC=y
CONFIG_POSIX_API=y
CONFIG_XOPEN_STREAMS=y

# Memory
CONFIG_MAIN_STACK_SIZE=8192
CONFIG_SYSTEM_WORKQUEUE_STACK_SIZE=4096
CONFIG_IDLE_STACK_SIZE=2048
CONFIG_HEAP_MEM_POOL_SIZE=46336

# Debugging
CONFIG_LOG=y
CONFIG_LOG_DEFAULT_LEVEL=2
CONFIG_PRINTK=y
CONFIG_EARLY_CONSOLE=y
CONFIG_ASSERT=n

# Hardware
CONFIG_SERIAL=y
CONFIG_UART_CONSOLE=y
CONFIG_CONSOLE=y
CONFIG_GPIO=y

# Networking
CONFIG_NETWORKING=y
CONFIG_NET_SOCKETS=y

# Network Stack
CONFIG_NET_IPV4=y
CONFIG_NET_IPV6=n
CONFIG_NET_UDP=y
CONFIG_NET_TCP=n
CONFIG_NET_DHCPV4=y

# Network Management
CONFIG_NET_L2_ETHERNET=y
CONFIG_NET_L2_ETHERNET_MGMT=y
CONFIG_NET_MGMT=y
CONFIG_NET_MGMT_EVENT=y

# WiFi Configuration
CONFIG_WIFI=y
CONFIG_NET_L2_WIFI_MGMT=y

# Security
CONFIG_ENTROPY_GENERATOR=y
CONFIG_TEST_RANDOM_GENERATOR=y
CONFIG_MBEDTLS=y
CONFIG_MBEDTLS_BUILTIN=y
CONFIG_MBEDTLS_ENABLE_HEAP=y
CONFIG_MBEDTLS_HEAP_SIZE=16384
CONFIG_MBEDTLS_USER_CONFIG_ENABLE=y
CONFIG_MBEDTLS_USER_CONFIG_FILE="config-mbedtls-libcoap.h"

# mbedTLS DTLS configuration
CONFIG_MBEDTLS_SSL_PROTO_TLS1_2=y
CONFIG_MBEDTLS_SSL_PROTO_DTLS=y
CONFIG_MBEDTLS_HMAC_DRBG_C=y

# libcoap
CONFIG_LIBCOAP=y
CONFIG_LIBCOAP_CLIENT_SUPPORT=y


# Disable memory-intensive features
CONFIG_SHELL=n
CONFIG_PM=n
CONFIG_SMP=n
```

## boards/esp32_devkitc_procpu.conf
```kconfig
# Minimal ESP32 Board Configuration
# boards/esp32_devkitc_wroom_procpu.conf

CONFIG_WIFI=y
CONFIG_WIFI_ESP32=y
CONFIG_ESP32_WIFI_STA_AUTO_DHCPV4=y
CONFIG_ESP32_USE_UNSUPPORTED_REVISION=y
```

## src/main.c
```c
/* minimal CoAP client
 *
 * Copyright (C) 2018-2024 Olaf Bergmann <bergmann@tzi.org>
 * Copyright (C) 2024-2025 Javier Blanco-Romero @fj-blanco (UC3M, QURSA project)
 */

#include <stdio.h>
#include <stdlib.h>
#include <string.h>
#include <zephyr/init.h>
#include <zephyr/kernel.h>
#include <zephyr/net/socket.h>
#include <zephyr/posix/unistd.h>
#include <zephyr/sys/slist.h>
#include <coap3/coap.h>
#include "wifi.h"

static int have_response = 0;

#ifndef COAP_SERVER_IP
#define COAP_SERVER_IP "134.102.218.18"
#endif

#ifndef COAP_SERVER_PATH
#define COAP_SERVER_PATH "/hello"
#endif

#ifndef COAP_SERVER_PORT
#define COAP_SERVER_PORT COAP_DEFAULT_PORT
#endif

#define COAP_CLIENT_URI "coap://" COAP_SERVER_IP COAP_SERVER_PATH

void cleanup_resources(coap_context_t *ctx, coap_session_t *session,
                       coap_optlist_t *optlist) {
    if (optlist)
        coap_delete_optlist(optlist);
    if (session)
        coap_session_release(session);
    if (ctx)
        coap_free_context(ctx);
    coap_cleanup();
}

int setup_destination_address(coap_address_t *dst, const char *host,
                              uint16_t port) {
    printf("Setting up destination address: %s:%d\n", host, port);

    memset(dst, 0, sizeof(coap_address_t));

    struct sockaddr_in *sin = (struct sockaddr_in *)&dst->addr.sin;
    sin->sin_family = AF_INET;
    sin->sin_port = htons(port);

    if (inet_pton(AF_INET, host, &sin->sin_addr) <= 0) {
        printf("Failed to convert IP address: %s\n", host);
        return 0;
    }

    dst->size = sizeof(struct sockaddr_in); // This is 8 bytes in Zephyr
    dst->addr.sa.sa_family = AF_INET;

    printf("Address size set to: %u (sizeof(struct sockaddr_in))\n", dst->size);
    printf("Address family: %d\n", dst->addr.sa.sa_family);
    printf("Target: %s:%d\n", host, port);

    // Additional verification - print what we actually set
    printf("Verification - sin_family: %d, sin_port: 0x%x, sin_addr: 0x%x\n",
           sin->sin_family, sin->sin_port, sin->sin_addr.s_addr);

    return 1;
}

static coap_response_t response_handler(coap_session_t *session,
                                        const coap_pdu_t *sent,
                                        const coap_pdu_t *received,
                                        const int id) {
    size_t len;
    const uint8_t *databuf;
    size_t offset;
    size_t total;

    (void)session;
    (void)sent;
    (void)id;

    have_response = 1;
    coap_show_pdu(COAP_LOG_WARN, received);
    if (coap_get_data_large(received, &len, &databuf, &offset, &total)) {
        fwrite(databuf, 1, len, stdout);
        fwrite("\n", 1, 1, stdout);
    }
    return COAP_RESPONSE_OK;
}

int main(void) {
    coap_context_t *ctx = NULL;
    coap_session_t *session = NULL;
    coap_optlist_t *optlist = NULL;
    coap_address_t dst;
    coap_pdu_t *pdu = NULL;
    int result = EXIT_FAILURE;
    int len;
    int res;
    unsigned int wait_ms;
    coap_uri_t uri;
    const char *coap_uri = COAP_CLIENT_URI;
    int is_mcast;
#define BUFSIZE 100
    unsigned char scratch[BUFSIZE];

    printf("Starting CoAP client......\n");

    /* Initialize libcoap library */
    coap_startup();

    /* Set logging level */
    coap_set_log_level(COAP_LOG_WARN);

    /* Parse the URI */
    len = coap_split_uri((const unsigned char *)coap_uri, strlen(coap_uri), &uri);
    if (len != 0) {
        coap_log_warn("Failed to parse uri %s\n", coap_uri);
        goto finish;
    } else {
        printf("URI parsed successfully......\n");
        printf("Parsed - Scheme: %d, Host: %.*s, Port: %d, Path: %.*s\n", 
               uri.scheme, (int)uri.host.length, uri.host.s,
               uri.port, (int)uri.path.length, uri.path.s);
    }

    wifi_init(NULL);

    int ret = connect_to_wifi();

    printf("Waiting for Wi-Fi connection...\n");
    if (wait_for_wifi_connection() < 0) {
        printf("Failed to connect to Wi-Fi within the timeout period\n");
        goto finish;
    }

    printf("Wi-Fi connected. Proceeding...\n");
    if (ret < 0) {
        printf("Wi-Fi connection failed\n");
        goto finish;
    } else {
        printf("Wi-Fi connection in progress\n");
    }

    /* Add delay to ensure network stack is ready */
    k_sleep(K_MSEC(1000));

    /* Extract host string from URI for address setup */
    char host_str[64];
    if (uri.host.length < sizeof(host_str)) {
        memcpy(host_str, uri.host.s, uri.host.length);
        host_str[uri.host.length] = '\0';
    } else {
        printf("Host string too long\n");
        goto finish;
    }

    /* Setup destination address with correct size */
    uint16_t port = uri.port ? uri.port : COAP_DEFAULT_PORT;
    if (!setup_destination_address(&dst, host_str, port)) {
        printf("Failed to setup destination address\n");
        goto finish;
    } else {
        printf("Address resolved......\n");
    }

    is_mcast = 0;
    printf("CoAP creating new context....\n");
    /* create CoAP context and a client session */
    if (!(ctx = coap_new_context(NULL))) {
        coap_log_emerg("cannot create libcoap context\n");
        goto finish;
    } else {
        printf("CoAP context created......\n");
    }

    /* Support large responses */
    coap_context_set_block_mode(ctx, COAP_BLOCK_USE_LIBCOAP |
                                         COAP_BLOCK_SINGLE_BODY);

    if (uri.scheme == COAP_URI_SCHEME_COAP) {
        session = coap_new_client_session(ctx, NULL, &dst, COAP_PROTO_UDP);
    } else if (uri.scheme == COAP_URI_SCHEME_COAP_TCP) {
        session = coap_new_client_session(ctx, NULL, &dst, COAP_PROTO_TCP);
    }
    if (!session) {
        coap_log_emerg("cannot create client session\n");
        goto finish;
    } else {
        printf("CoAP session created......\n");
    }

    coap_register_response_handler(ctx, response_handler);

    /* construct CoAP message */
    pdu = coap_pdu_init(is_mcast ? COAP_MESSAGE_NON : COAP_MESSAGE_CON,
                        COAP_REQUEST_CODE_GET, coap_new_message_id(session),
                        coap_session_max_pdu_size(session));
    if (!pdu) {
        coap_log_emerg("cannot create PDU\n");
        goto finish;
    }

    /* Add option list (which will be sorted) to the PDU */
    len = coap_uri_into_options(&uri, &dst, &optlist, 1, scratch,
                                sizeof(scratch));
    if (len) {
        coap_log_warn("Failed to create options\n");
        goto finish;
    }

    if (optlist) {
        res = coap_add_optlist_pdu(pdu, &optlist);
        if (res != 1) {
            coap_log_warn("Failed to add options to PDU\n");
            goto finish;
        }
    }

    coap_show_pdu(COAP_LOG_WARN, pdu);

    printf(
        "About to send CoAP packet using default libcoap socket function...\n");
    /* and send the PDU */
    if (coap_send(session, pdu) == COAP_INVALID_MID) {
        coap_log_err("cannot send CoAP pdu\n");
        goto finish;
    } else {
        printf("CoAP packet sent successfully using default libcoap!\n");
    }

    wait_ms =
        (coap_session_get_default_leisure(session).integer_part + 1) * 1000;

    while (have_response == 0 || is_mcast) {
        res = coap_io_process(ctx, 500);
        if (res >= 0) {
            if (wait_ms > 0) {
                if ((unsigned)res >= wait_ms) {
                    fprintf(stdout, "timeout\n");
                    break;
                } else {
                    wait_ms -= res;
                }
            }
        }
    }

    if (have_response != 0) {
        printf("SUCCESS: Response received using default libcoap!\n");
        result = EXIT_SUCCESS;
        goto finish;
    }

    result = EXIT_SUCCESS;
finish:
    printf("Cleaning up resources...\n");
    cleanup_resources(ctx, session, optlist);
    wifi_disconnect();
    printf("CLIENT FINISHED.\n");

    return result;
}
```

## include/wifi.h
```c
/*
* mbedtls/include/wifi.h
*
* Copyright (C) 2024-2025 Javier Blanco-Romero @fj-blanco (UC3M, QURSA project)
* Author: Javier Blanco-Romero
*
* Wi-Fi management header for CoAP client
*/

#include <zephyr/kernel.h>
#include <zephyr/net/net_if.h>
#include <zephyr/net/wifi_mgmt.h>

extern struct wifi_connect_req_params wifi_params;
void wifi_mgmt_event_handler(struct net_mgmt_event_callback *cb,
                             uint32_t mgmt_event, struct net_if *iface);
int wifi_init(struct device *unused);
int shell_cmd_scan(void);
int wait_for_wifi_connection(void);
int connect_to_wifi(void);
void wifi_disconnect(void);
```

## src/wifi.c
```c
/*
 * mbedtls/src/wifi.c
 *
 * Copyright (C) 2024-2025 Javier Blanco-Romero @fj-blanco (UC3M, QURSA project)
 *
 * Wi-Fi management for CoAP client
 */

#include <stdio.h>
#include <zephyr/net/net_event.h>
#include <zephyr/net/net_if.h>
#include <zephyr/net/socket.h>
#include <zephyr/net/wifi_mgmt.h>
#include <zephyr/net/wifi_utils.h>
#include "wifi.h"

#define WIFI_SSID "your_ssid"
#define WIFI_PASS "your_password"

#define WIFI_CONNECTION_TIMEOUT_MS 10000 // 10 seconds

struct wifi_connect_req_params wifi_params = {
    .ssid = WIFI_SSID,
    .ssid_length = sizeof(WIFI_SSID) - 1,
    .psk = WIFI_PASS,
    .psk_length = sizeof(WIFI_PASS) - 1,
    .channel = WIFI_CHANNEL_ANY,
    .security = WIFI_SECURITY_TYPE_PSK,
    .mfp = WIFI_MFP_OPTIONAL,
    .timeout = SYS_FOREVER_MS};

#define WIFI_SHELL_MGMT_EVENTS                                                 \
    (NET_EVENT_WIFI_SCAN_RESULT | NET_EVENT_WIFI_SCAN_DONE |                   \
     NET_EVENT_WIFI_CONNECT_RESULT | NET_EVENT_WIFI_DISCONNECT_RESULT)

static union {
    struct {
        uint8_t connecting : 1;
        uint8_t disconnecting : 1;
        uint8_t _unused : 6;
    };
    uint8_t all;
} context;

static uint32_t scan_result;
static bool wifi_connected = false;
static struct net_mgmt_event_callback wifi_event_cb;

static void handle_wifi_scan_result(struct net_mgmt_event_callback *cb) {
    const struct wifi_scan_result *entry =
        (const struct wifi_scan_result *)cb->info;

    scan_result++;

    if (scan_result == 1) {
        printf("\n%-4s | %-32s %-5s | %-4s | %-4s | %-5s\n", "Num", "SSID",
               "(len)", "Chan", "RSSI", "Sec");
    }

    printf("%-4d | %-32s %-5u | %-4u | %-4d | %-5s\n", scan_result, entry->ssid,
           entry->ssid_length, entry->channel, entry->rssi,
           (entry->security == WIFI_SECURITY_TYPE_PSK ? "WPA/WPA2" : "Open"));
}

static void handle_wifi_scan_done(struct net_mgmt_event_callback *cb) {
    const struct wifi_status *status = (const struct wifi_status *)cb->info;

    if (status->status) {
        printf("\nWi-Fi scan request failed (%d)\n", status->status);
    } else {
        printf("----------\n");
        printf("Wi-Fi scan request done\n");
    }

    scan_result = 0;
}

static void handle_wifi_connect_result(struct net_mgmt_event_callback *cb) {
    const struct wifi_status *status = (const struct wifi_status *)cb->info;

    if (status->status) {
        printf("\nWi-Fi connection request failed (%d)\n", status->status);
    } else {
        printf("\nWi-Fi connected\n");
        wifi_connected = true;
    }

    context.connecting = false;
}

static void handle_wifi_disconnect_result(struct net_mgmt_event_callback *cb) {
    const struct wifi_status *status = (const struct wifi_status *)cb->info;

    if (context.disconnecting) {
        printf("\nWi-Fi disconnection request %s (%d)\n",
               status->status ? "failed" : "done", status->status);
        context.disconnecting = false;
    } else {
        printf("\nWi-Fi Disconnected\n");
    }
}

void wifi_mgmt_event_handler(struct net_mgmt_event_callback *cb,
                             uint32_t mgmt_event, struct net_if *iface) {
    switch (mgmt_event) {
    case NET_EVENT_WIFI_SCAN_RESULT:
        handle_wifi_scan_result(cb);
        break;
    case NET_EVENT_WIFI_SCAN_DONE:
        handle_wifi_scan_done(cb);
        break;
    case NET_EVENT_WIFI_CONNECT_RESULT:
        handle_wifi_connect_result(cb);
        break;
    case NET_EVENT_WIFI_DISCONNECT_RESULT:
        handle_wifi_disconnect_result(cb);
        break;
    default:
        break;
    }
}

int wifi_init(struct device *unused) {
    ARG_UNUSED(unused);

    context.all = 0;
    scan_result = 0;

    net_mgmt_init_event_callback(&wifi_event_cb, wifi_mgmt_event_handler,
                                 WIFI_SHELL_MGMT_EVENTS);

    printf("Wi-Fi event callback initialized......\n");
    net_mgmt_add_event_callback(&wifi_event_cb);

    return 0;
}

int shell_cmd_scan() {
    struct net_if *iface = net_if_get_default();

    if (net_mgmt(NET_REQUEST_WIFI_SCAN, iface, NULL, 0)) {
        printf("Wi-Fi scan request failed\n");
    } else {
        printf("Wi-Fi scan requested\n");
    }

    return 0;
}

int wait_for_wifi_connection(void) {
    int timeout_count = 0;
    int max_timeout_count = WIFI_CONNECTION_TIMEOUT_MS / 100;

    while (!wifi_connected) {
        k_sleep(K_MSEC(100)); // Sleep for 100 ms
        timeout_count++;

        if (timeout_count >= max_timeout_count) {
            printf("Wi-Fi connection timeout after %d ms\n",
                   WIFI_CONNECTION_TIMEOUT_MS);
            return -ETIMEDOUT;
        }
    }

    printf("Wi-Fi connected successfully\n");
    return 0;
}

void wifi_disconnect(void) {
    struct net_if *iface = net_if_get_default();

    if (net_mgmt(NET_REQUEST_WIFI_DISCONNECT, iface, NULL, 0)) {
        printf("Wi-Fi Disconnection Request Failed\n");
    } else {
        printf("Wi-Fi Disconnection Requested\n");
    }
}

int connect_to_wifi() {
    printf("Connecting to Wi-Fi network......\n");
    int ret;

    struct net_if *iface = net_if_get_default();

    if (!iface) {
        printf("Failed to get Wi-Fi device\n");
        return -ENODEV;
    }
    ret = net_mgmt(NET_REQUEST_WIFI_CONNECT, iface, &wifi_params,
                   sizeof(struct wifi_connect_req_params));

    if (ret < 0) {
        printf("Failed to connect to Wi-Fi network: %d\n", ret);
        return ret;
    }

    printf("Wi-Fi connection requested\n");
    return ret;
}
```
