## CMakeLists.txt
```
#
# wolfssl/CMakeLists.txt
#
# Copyright (C) 2024-2025 Javier Blanco-Romero @fj-blanco (UC3M, QURSA project)
#
# CMake configuration for CoAP client with wolfSSL
#

cmake_minimum_required(VERSION 3.20.0)

find_package(Zephyr REQUIRED HINTS $ENV{ZEPHYR_BASE})
project(libcoap_wolfssl_client)

# CoAP server configuration
set(COAP_SERVER_IP_VALUE $ENV{COAP_IP})
set(COAP_SERVER_PATH_VALUE $ENV{COAP_PATH})
set(COAP_SERVER_PORT_VALUE $ENV{COAP_PORT})

if(DEFINED COAP_IP)
    set(COAP_SERVER_IP_VALUE ${COAP_IP})
endif()

if(DEFINED COAP_PATH)
    set(COAP_SERVER_PATH_VALUE ${COAP_PATH})
endif()

if(DEFINED COAP_PORT)
    set(COAP_SERVER_PORT_VALUE ${COAP_PORT})
endif()

if(NOT COAP_SERVER_IP_VALUE)
    set(COAP_SERVER_IP_VALUE "134.102.218.18")
endif()

if(NOT COAP_SERVER_PATH_VALUE)
    set(COAP_SERVER_PATH_VALUE "/hello")
endif()

if(NOT COAP_SERVER_PORT_VALUE)
    set(COAP_SERVER_PORT_VALUE "5683")
endif()

# DTLS configuration
set(USE_DTLS_VALUE $ENV{USE_DTLS})
if(DEFINED USE_DTLS)
    set(USE_DTLS_VALUE ${USE_DTLS})
endif()

# Handle WiFi configuration
set(WIFI_SSID_VALUE $ENV{WIFI_SSID})
set(WIFI_PASS_VALUE $ENV{WIFI_PASS})

if(DEFINED WIFI_SSID)
    set(WIFI_SSID_VALUE ${WIFI_SSID})
endif()

if(DEFINED WIFI_PASS)
    set(WIFI_PASS_VALUE ${WIFI_PASS})
endif()

if(NOT WIFI_SSID_VALUE)
    set(WIFI_SSID_VALUE "WIFI_SSID_NOT_SET")
endif()

if(NOT WIFI_PASS_VALUE)
    set(WIFI_PASS_VALUE "WIFI_PASS_NOT_SET")
endif()

zephyr_include_directories(include)

target_include_directories(app PRIVATE ${CMAKE_CURRENT_SOURCE_DIR}/include)
target_sources(app PRIVATE src/main.c src/wifi.c)
target_link_libraries(app PRIVATE coap-3)

target_compile_definitions(app PRIVATE
    COAP_SERVER_IP="${COAP_SERVER_IP_VALUE}"
    COAP_SERVER_PATH="${COAP_SERVER_PATH_VALUE}"
    COAP_SERVER_PORT=${COAP_SERVER_PORT_VALUE}
    WIFI_SSID="${WIFI_SSID_VALUE}"
    WIFI_PASS="${WIFI_PASS_VALUE}"
)

# Add DTLS support if enabled
if(USE_DTLS_VALUE)
    target_compile_definitions(app PRIVATE USE_DTLS=1)
    message(STATUS "DTLS mode: ENABLED")
else()
    message(STATUS "DTLS mode: DISABLED")
endif()

message(STATUS "...............................................")
message(STATUS "ZEPHYR_EXTRA_MODULES after Zephyr package: ${ZEPHYR_EXTRA_MODULES}")
message(STATUS "wolfSSL configuration enabled")
message(STATUS "CoAP Server: ${COAP_SERVER_IP_VALUE}${COAP_SERVER_PATH_VALUE}:${COAP_SERVER_PORT_VALUE}")
message(STATUS "WiFi Network: ${WIFI_SSID_VALUE}")
message(STATUS "...............................................")
```

## Kconfig
```
# wolfssl/Kconfig
#
# Copyright (C) 2024-2025 Javier Blanco-Romero @fj-blanco (UC3M, QURSA project)
#
# Kconfig for wolfSSL CoAP client

mainmenu "wolfSSL CoAP Client Configuration"

source "Kconfig.zephyr"
```

## sample.yaml
```
sample:
  name: CoAP Client with wolfSSL
  description: Secure CoAP client using wolfSSL for ESP32

common:
  tags: coap dtls wolfssl esp32 networking
  depends_on: wifi
  integration_platforms:
    - esp32_devkitc_wroom
  harness: net
```

## west.yml
```
manifest:
  defaults:
    remote: zephyrproject
  remotes:
    - name: zephyrproject
      url-base: https://github.com/zephyrproject-rtos
    - name: libcoap-fork
      url-base: https://github.com/fj-blanco
    - name: wolfssl
      url-base: https://github.com/wolfssl
  projects:
    - name: zephyr
      remote: zephyrproject
      repo-path: zephyr
      revision: v4.3.0
      path: zephyr
      import:
        name-allowlist:
          - hal_espressif  # ESP32 HAL
          - mbedtls        # Required for WiFi (even with wolfSSL for CoAP)
          - picolibc       # C library
    - name: libcoap
      remote: libcoap-fork
      repo-path: libcoap
      revision: fix/zephyr-wolfssl-target-check
      path: modules/lib/libcoap
    - name: wolfssl
      remote: wolfssl
      repo-path: wolfssl
      revision: v5.8.4-stable
      path: modules/crypto/wolfssl
  self:
    path: .
```

## prj.conf
```kconfig
# ESP32 libcoap wolfSSL Configuration

# Core System
CONFIG_NEWLIB_LIBC=y
CONFIG_POSIX_API=y
CONFIG_XOPEN_STREAMS=y

# Memory
CONFIG_MAIN_STACK_SIZE=8192
CONFIG_SYSTEM_WORKQUEUE_STACK_SIZE=4096
CONFIG_IDLE_STACK_SIZE=2048
CONFIG_HEAP_MEM_POOL_SIZE=46336

# Debugging
CONFIG_LOG=y
CONFIG_LOG_DEFAULT_LEVEL=2
CONFIG_PRINTK=y
CONFIG_EARLY_CONSOLE=y
CONFIG_ASSERT=n

# Hardware
CONFIG_SERIAL=y
CONFIG_UART_CONSOLE=y
CONFIG_CONSOLE=y
CONFIG_GPIO=y

# Networking
CONFIG_NETWORKING=y
CONFIG_NET_SOCKETS=y

# Network Stack
CONFIG_NET_IPV4=y
CONFIG_NET_IPV6=n
CONFIG_NET_UDP=y
CONFIG_NET_TCP=n
CONFIG_NET_DHCPV4=y

# Network Management
CONFIG_NET_L2_ETHERNET=y
CONFIG_NET_L2_ETHERNET_MGMT=y
CONFIG_NET_MGMT=y
CONFIG_NET_MGMT_EVENT=y

# WiFi Configuration
CONFIG_WIFI=y
CONFIG_NET_L2_WIFI_MGMT=y

# -------- MbedTLS --------
CONFIG_MBEDTLS=y
CONFIG_MBEDTLS_BUILTIN=y
CONFIG_MBEDTLS_ENABLE_HEAP=y
CONFIG_MBEDTLS_HEAP_SIZE=16384
CONFIG_MBEDTLS_USER_CONFIG_ENABLE=y
CONFIG_MBEDTLS_USER_CONFIG_FILE="config-mbedtls-wifi.h"

# Security - wolfSSL instead of mbedTLS
CONFIG_ENTROPY_GENERATOR=y
CONFIG_TEST_RANDOM_GENERATOR=y
CONFIG_WOLFSSL=y
CONFIG_WOLFSSL_SETTINGS_FILE="config-wolfssl-libcoap.h"

# libcoap
CONFIG_LIBCOAP=y
CONFIG_LIBCOAP_CLIENT_SUPPORT=y

# Disable memory-intensive features
CONFIG_SHELL=n
CONFIG_PM=n
CONFIG_SMP=n
```

## prj_pqc.conf
```kconfig
# =============================================================================
# prj_pqc.conf - Zephyr configuration overlay for Post-Quantum Cryptography
# =============================================================================
# This overlay enables ML-KEM (Kyber) key exchange on ESP32 with wolfSSL.
# 
# Usage:
#   west build -b esp32_devkitc/esp32/procpu . -- -DEXTRA_CONF_FILE=prj_pqc.conf
#
# Or merge with prj.conf:
#   cat prj.conf prj_pqc.conf > prj_pqc_merged.conf
#   west build -b esp32_devkitc/esp32/procpu . -- -DCONF_FILE=prj_pqc_merged.conf
# =============================================================================

# Increased stack sizes for ML-KEM operations
# ML-KEM-768 requires approximately 10KB+ of stack space
CONFIG_MAIN_STACK_SIZE=16384
CONFIG_SYSTEM_WORKQUEUE_STACK_SIZE=8192
CONFIG_IDLE_STACK_SIZE=2048

# Increased heap for PQC key material
# ML-KEM public keys are ~1KB, ciphertexts ~1KB
CONFIG_HEAP_MEM_POOL_SIZE=65536

# Use PQC-enabled wolfSSL configuration
CONFIG_WOLFSSL_SETTINGS_FILE="config-wolfssl-libcoap-pqc.h"

# Enable debug for development
CONFIG_WOLFSSL_DEBUG=y
CONFIG_LOG_DEFAULT_LEVEL=3
```

## boards/esp32_devkitc_procpu.conf
```kconfig
# ESP32 Board Configuration
# boards/esp32_devkitc_wroom_procpu.conf

CONFIG_WIFI=y
CONFIG_WIFI_ESP32=y # Enabling this will load MBEDTLS for the WiFi drivers
CONFIG_ESP32_WIFI_STA_AUTO_DHCPV4=y
CONFIG_ESP32_USE_UNSUPPORTED_REVISION=y
```

## src/main.c
```c
/* minimal CoAP client
 *
 * Copyright (C) 2018-2024 Olaf Bergmann <bergmann@tzi.org>
 * Copyright (C) 2024-2025 Javier Blanco-Romero @fj-blanco (UC3M, QURSA project)
 */

#include <stdio.h>
#include <stdlib.h>
#include <string.h>
#include <zephyr/init.h>
#include <zephyr/kernel.h>
#include <zephyr/net/socket.h>
#include <zephyr/posix/unistd.h>
#include <zephyr/sys/slist.h>
#include <coap3/coap.h>
#include "wifi.h"

static int have_response = 0;

#ifndef COAP_SERVER_IP
#define COAP_SERVER_IP "134.102.218.18"
#endif

#ifndef COAP_SERVER_PATH
#define COAP_SERVER_PATH "/hello"
#endif

#ifndef COAP_SERVER_PORT
#ifdef USE_DTLS
#define COAP_SERVER_PORT COAPS_DEFAULT_PORT
#else
#define COAP_SERVER_PORT COAP_DEFAULT_PORT
#endif
#endif

#ifdef USE_DTLS
#define COAP_CLIENT_URI "coaps://" COAP_SERVER_IP COAP_SERVER_PATH
#else
#define COAP_CLIENT_URI "coap://" COAP_SERVER_IP COAP_SERVER_PATH
#endif

void cleanup_resources(coap_context_t *ctx, coap_session_t *session,
                       coap_optlist_t *optlist) {
    if (optlist)
        coap_delete_optlist(optlist);
    if (session)
        coap_session_release(session);
    if (ctx)
        coap_free_context(ctx);
    coap_cleanup();
}

int setup_destination_address(coap_address_t *dst, const char *host,
                              uint16_t port) {
    printf("Setting up destination address: %s:%d\n", host, port);

    memset(dst, 0, sizeof(coap_address_t));

    struct sockaddr_in *sin = (struct sockaddr_in *)&dst->addr.sin;
    sin->sin_family = AF_INET;
    sin->sin_port = htons(port);

    if (inet_pton(AF_INET, host, &sin->sin_addr) <= 0) {
        printf("Failed to convert IP address: %s\n", host);
        return 0;
    }

    dst->size = sizeof(struct sockaddr_in); // This is 8 bytes in Zephyr
    dst->addr.sa.sa_family = AF_INET;

    printf("Address size set to: %u (sizeof(struct sockaddr_in))\n", dst->size);
    printf("Address family: %d\n", dst->addr.sa.sa_family);
    printf("Target: %s:%d\n", host, port);

    printf("Verification - sin_family: %d, sin_port: 0x%x, sin_addr: 0x%x\n",
           sin->sin_family, sin->sin_port, sin->sin_addr.s_addr);

    return 1;
}

static coap_response_t response_handler(coap_session_t *session,
                                        const coap_pdu_t *sent,
                                        const coap_pdu_t *received,
                                        const int id) {
    size_t len;
    const uint8_t *databuf;
    size_t offset;
    size_t total;

    (void)session;
    (void)sent;
    (void)id;

    have_response = 1;
    printf("\n=== RESPONSE RECEIVED ===\n");
    coap_show_pdu(COAP_LOG_WARN, received);
    if (coap_get_data_large(received, &len, &databuf, &offset, &total)) {
        printf("Response data: ");
        fwrite(databuf, 1, len, stdout);
        printf("\n");
    }
    printf("=== END RESPONSE ===\n");
    return COAP_RESPONSE_OK;
}

void verify_tls_backend(void) {
    printf("\n=== TLS Backend Verification ===\n");
    
    coap_tls_version_t *tls_version = coap_get_tls_library_version();
    
    if (!tls_version) {
        printf("Failed to get TLS library version\n");
        return;
    }
    
    printf("TLS Library Type: %d\n", tls_version->type);
    
    switch (tls_version->type) {
        case COAP_TLS_LIBRARY_NOTLS:
            printf("No TLS support\n");
            break;
        case COAP_TLS_LIBRARY_TINYDTLS:
            printf("Using TinyDTLS backend\n");
            break;
        case COAP_TLS_LIBRARY_OPENSSL:
            printf("Using OpenSSL backend\n");
            break;
        case COAP_TLS_LIBRARY_GNUTLS:
            printf("Using GnuTLS backend\n");
            break;
        case COAP_TLS_LIBRARY_MBEDTLS:
            printf("Using mbedTLS backend\n");
            break;
        case COAP_TLS_LIBRARY_WOLFSSL:
            printf("Using wolfSSL backend\n");
            break;
        default:
            printf("Unknown TLS backend (type: %d)\n", tls_version->type);
            break;
    }
    
    printf("DTLS supported: %s\n", coap_dtls_is_supported() ? "Yes" : "No");
    printf("DTLS PSK supported: %s\n", coap_dtls_psk_is_supported() ? "Yes" : "No");
    printf("DTLS PKI supported: %s\n", coap_dtls_pki_is_supported() ? "Yes" : "No");
    
    printf("=== End TLS Backend Verification ===\n\n");
}

#ifdef USE_DTLS
/* Minimal PKI setup - disables certificate verification */
static coap_dtls_pki_t *setup_minimal_pki(void) {
    static coap_dtls_pki_t dtls_pki;
    
    memset(&dtls_pki, 0, sizeof(dtls_pki));
    dtls_pki.version = COAP_DTLS_PKI_SETUP_VERSION;
    dtls_pki.verify_peer_cert = 0;  // Disable certificate verification
    dtls_pki.is_rpk_not_cert = 0;
    
    return &dtls_pki;
}
#endif

int main(void) {
    coap_context_t *ctx = NULL;
    coap_session_t *session = NULL;
    coap_optlist_t *optlist = NULL;
    coap_address_t dst;
    coap_pdu_t *pdu = NULL;
    int result = EXIT_FAILURE;
    int len;
    int res;
    unsigned int wait_ms;
    coap_uri_t uri;
    const char *coap_uri = COAP_CLIENT_URI;
    int is_mcast;
#define BUFSIZE 100
    unsigned char scratch[BUFSIZE];

    printf("=== CoAP Client Configuration ===\n");
    printf("Target URI: %s\n", coap_uri);
    printf("Server IP: %s\n", COAP_SERVER_IP);
    printf("Server Path: %s\n", COAP_SERVER_PATH);
    printf("Server Port: %d\n", COAP_SERVER_PORT);
#ifdef USE_DTLS
    printf("DTLS Mode: ENABLED\n");
#else
    printf("DTLS Mode: DISABLED\n");
#endif
    printf("================================\n\n");

    printf("Starting CoAP client......\n");

    /* Initialize libcoap library */
    coap_startup();

    /* Verify which TLS backend is being used */
    verify_tls_backend();

    /* Set logging level */
    coap_set_log_level(COAP_LOG_WARN);

    /* Parse the URI */
    len = coap_split_uri((const unsigned char *)coap_uri, strlen(coap_uri), &uri);
    if (len != 0) {
        coap_log_warn("Failed to parse uri %s\n", coap_uri);
        goto finish;
    } else {
        printf("URI parsed successfully......\n");
        printf("Parsed - Scheme: %d, Host: %.*s, Port: %d, Path: %.*s\n", 
               uri.scheme, (int)uri.host.length, uri.host.s,
               uri.port, (int)uri.path.length, uri.path.s);
    }

    wifi_init(NULL);

    /* WiFi connection with retries */
    int wifi_connected = 0;
    for (int attempt = 1; attempt <= 3 && !wifi_connected; attempt++) {
        if (attempt > 1) {
            printf("WiFi retry attempt %d/3...\n", attempt);
        }
        
        int ret = connect_to_wifi();
        if (ret >= 0 && wait_for_wifi_connection() >= 0) {
            wifi_connected = 1;
        } else {
            printf("WiFi connection attempt %d failed\n", attempt);
            if (attempt < 3) {
                wifi_disconnect();
                k_sleep(K_MSEC(2000)); // Wait 2 seconds before retry
            }
        }
    }

    if (!wifi_connected) {
        printf("Failed to connect to WiFi after 3 attempts\n");
        goto finish;
    }

    /* Add delay to ensure network stack is ready */
    k_sleep(K_MSEC(1000));

    /* Extract host string from URI for address setup */
    char host_str[64];
    if (uri.host.length < sizeof(host_str)) {
        memcpy(host_str, uri.host.s, uri.host.length);
        host_str[uri.host.length] = '\0';
    } else {
        printf("Host string too long\n");
        goto finish;
    }

    /* Setup destination address with correct size */
    uint16_t port = uri.port ? uri.port : COAP_SERVER_PORT;
    if (!setup_destination_address(&dst, host_str, port)) {
        printf("Failed to setup destination address\n");
        goto finish;
    } else {
        printf("Address resolved......\n");
    }

    is_mcast = 0;
    printf("CoAP creating new context....\n");
    /* create CoAP context and a client session */
    if (!(ctx = coap_new_context(NULL))) {
        coap_log_emerg("cannot create libcoap context\n");
        goto finish;
    } else {
        printf("CoAP context created......\n");
    }

    /* Support large responses */
    coap_context_set_block_mode(ctx, COAP_BLOCK_USE_LIBCOAP |
                                         COAP_BLOCK_SINGLE_BODY);

    /* Create session based on URI scheme */
    if (uri.scheme == COAP_URI_SCHEME_COAP) {
        session = coap_new_client_session(ctx, NULL, &dst, COAP_PROTO_UDP);
    } else if (uri.scheme == COAP_URI_SCHEME_COAP_TCP) {
        session = coap_new_client_session(ctx, NULL, &dst, COAP_PROTO_TCP);
#ifdef USE_DTLS
    } else if (uri.scheme == COAP_URI_SCHEME_COAPS) {
        /* DTLS session with minimal PKI (no cert verification) */
        coap_dtls_pki_t *dtls_pki = setup_minimal_pki();
        session = coap_new_client_session_pki(ctx, NULL, &dst, COAP_PROTO_DTLS, dtls_pki);
#endif
    }
    if (!session) {
        coap_log_emerg("cannot create client session\n");
        goto finish;
    } else {
        printf("CoAP session created......\n");
    }

    coap_register_response_handler(ctx, response_handler);

    /* construct CoAP message */
    pdu = coap_pdu_init(is_mcast ? COAP_MESSAGE_NON : COAP_MESSAGE_CON,
                        COAP_REQUEST_CODE_GET, coap_new_message_id(session),
                        coap_session_max_pdu_size(session));
    if (!pdu) {
        coap_log_emerg("cannot create PDU\n");
        goto finish;
    }

    /* Add option list (which will be sorted) to the PDU */
    len = coap_uri_into_options(&uri, &dst, &optlist, 1, scratch,
                                sizeof(scratch));
    if (len) {
        coap_log_warn("Failed to create options\n");
        goto finish;
    }

    if (optlist) {
        res = coap_add_optlist_pdu(pdu, &optlist);
        if (res != 1) {
            coap_log_warn("Failed to add options to PDU\n");
            goto finish;
        }
    }

    coap_show_pdu(COAP_LOG_WARN, pdu);

    printf("About to send CoAP packet...\n");
    /* and send the PDU */
    if (coap_send(session, pdu) == COAP_INVALID_MID) {
        coap_log_err("cannot send CoAP pdu\n");
        goto finish;
    } else {
        printf("CoAP packet sent successfully!\n");
    }

    wait_ms = (coap_session_get_default_leisure(session).integer_part + 1) * 1000;

    printf("Waiting for response...\n");
    while (have_response == 0 || is_mcast) {
        res = coap_io_process(ctx, 500);
        if (res >= 0) {
            if (wait_ms > 0) {
                if ((unsigned)res >= wait_ms) {
                    printf("TIMEOUT: No response received\n");
                    break;
                } else {
                    wait_ms -= res;
                }
            }
        }
    }

    if (have_response != 0) {
        printf("SUCCESS: Response received!\n");
        result = EXIT_SUCCESS;
        goto finish;
    } else {
        printf("FAILED: No response received\n");
    }

    result = EXIT_SUCCESS;
finish:
    printf("Cleaning up resources...\n");
    cleanup_resources(ctx, session, optlist);
    wifi_disconnect();
    printf("CLIENT FINISHED.\n");

    return result;
}
```

## include/config-mbedtls-wifi.h
```c
/*
 * Copyright (C) 2006-2015, ARM Limited, All Rights Reserved
 * Copyright (c) 2017 Intel Corporation.
 * Copyright (c) 2018 Nordic Semiconductor ASA
 * Copyright (C) 2024-2025 Javier Blanco-Romero @fj-blanco (UC3M, QURSA project)
 *
 * SPDX-License-Identifier: Apache-2.0
 *
 * libcoap configuration for (D)TLS, manageable by Kconfig.
 */

#ifndef CONFIG_MBEDTLS_LIBCOAP_H
#define CONFIG_MBEDTLS_LIBCOAP_H

#if defined(__unix__) || defined(_WIN32)
#ifndef MBEDTLS_TIMING_C
#define MBEDTLS_TIMING_C
#endif /* ! MBEDTLS_TIMING_C */
#endif /* Unix/Windows platforms */

#ifndef MBEDTLS_VERSION_C
#define MBEDTLS_VERSION_C
#endif /* ! MBEDTLS_VERSION_C */

#ifndef MBEDTLS_CTR_DRBG_C
#define MBEDTLS_CTR_DRBG_C
#endif /* ! MBEDTLS_CTR_DRBG_C */

#ifndef MBEDTLS_AES_C
#define MBEDTLS_AES_C
#endif /* ! MBEDTLS_AES_C */

#ifndef MBEDTLS_ENTROPY_C
#define MBEDTLS_ENTROPY_C
#endif /* ! MBEDTLS_ENTROPY_C */

#if defined(MBEDTLS_KEY_EXCHANGE_ECDH_ECDSA_ENABLED)
#ifndef MBEDTLS_CAN_ECDH
#define MBEDTLS_CAN_ECDH
#endif /* ! MBEDTLS_CAN_ECDH */

#ifndef MBEDTLS_PK_CAN_ECDSA_SIGN
#define MBEDTLS_PK_CAN_ECDSA_SIGN
#endif /* ! MBEDTLS_PK_CAN_ECDSA_SIGN */

#ifndef MBEDTLS_X509_CRT_PARSE_C
#define MBEDTLS_X509_CRT_PARSE_C
#endif /* ! MBEDTLS_X509_CRT_PARSE_C */
#endif /* MBEDTLS_KEY_EXCHANGE_ECDH_ECDSA_ENABLED */

#if defined(MBEDTLS_KEY_EXCHANGE_ECDH_RSA_ENABLED)
#ifndef MBEDTLS_CAN_ECDH
#define MBEDTLS_CAN_ECDH
#endif /* ! MBEDTLS_CAN_ECDH */

#ifndef MBEDTLS_RSA_C
#define MBEDTLS_RSA_C
#endif /* ! MBEDTLS_RSA_C */

#ifndef MBEDTLS_X509_CRT_PARSE_C
#define MBEDTLS_X509_CRT_PARSE_C
#endif /* ! MBEDTLS_X509_CRT_PARSE_C */
#endif /* MBEDTLS_KEY_EXCHANGE_ECDH_RSA_ENABLED */

#if defined(MBEDTLS_KEY_EXCHANGE_ECDHE_PSK_ENABLED)
#ifndef MBEDTLS_CAN_ECDH
#define MBEDTLS_CAN_ECDH
#endif /* ! MBEDTLS_CAN_ECDH */
#endif /* MBEDTLS_KEY_EXCHANGE_ECDHE_PSK_ENABLED */

#if defined(MBEDTLS_ENTROPY_C)
#ifndef MBEDTLS_MD_CAN_SHA256
#define MBEDTLS_MD_CAN_SHA256
#endif /* ! MBEDTLS_MD_CAN_SHA256 */
#endif /* MBEDTLS_ENTROPY_C */

#if defined(MBEDTLS_CCM_C)
#ifndef MBEDTLS_CCM_GCM_CAN_AES
#define MBEDTLS_CCM_GCM_CAN_AES
#endif /* ! MBEDTLS_MD_CAN_SHA256 */
#endif /* MBEDTLS_CCM_C */

#if defined(MBEDTLS_GCM_C)
#ifndef MBEDTLS_CCM_GCM_CAN_AES
#define MBEDTLS_CCM_GCM_CAN_AES
#endif /* ! MBEDTLS_CCM_GCM_CAN_AES */
#endif /* MBEDTLS_GCM_C */

#if defined(MBEDTLS_KEY_EXCHANGE_ECJPAKE_ENABLED)
#ifndef PSA_WANT_ECC_SECP_R1_256
#define PSA_WANT_ECC_SECP_R1_256
#endif /* ! PSA_WANT_ECC_SECP_R1_256 */
#ifndef PMBEDTLS_ECP_DP_SECP256R1_ENABLED
#define MBEDTLS_ECP_DP_SECP256R1_ENABLED
#endif /* ! MBEDTLS_ECP_DP_SECP256R1_ENABLED */
#endif /* MBEDTLS_KEY_EXCHANGE_ECJPAKE_ENABLED */

#if defined(MBEDTLS_MD_C)
#ifndef MBEDTLS_MD_CAN_SHA256
#define MBEDTLS_MD_CAN_SHA256
#endif /* ! MBEDTLS_MD_CAN_SHA256 */
#endif /* MBEDTLS_MD_C */

#endif /* CONFIG_MBEDTLS_LIBCOAP_H */
```

## include/config-wolfssl-libcoap-pqc.h
```c
/*
 * config-wolfssl-libcoap-pqc.h
 * wolfSSL configuration for libcoap ESP32 client with Post-Quantum Cryptography
 * 
 * This configuration enables ML-KEM (Kyber) key exchange for DTLS 1.3.
 * ML-KEM-768 is recommended for ESP32 (balance of security and performance).
 * 
 * Copyright (C) 2024-2025 Javier Blanco-Romero @fj-blanco (UC3M, QURSA project)
 * 
 * PQC Configuration Options:
 *   ENABLE_MLKEM         - Enable ML-KEM key exchange (requires DTLS 1.3)
 *   MLKEM_LEVEL          - Security level: 1 (512), 3 (768), 5 (1024)
 *   ENABLE_HYBRID_KEM    - Enable hybrid (ECC + ML-KEM) key exchange
 */

#ifndef WOLFSSL_SETTINGS_H
#define WOLFSSL_SETTINGS_H

#ifdef __cplusplus
extern "C" {
#endif

#ifndef WOLFSSL_USER_SETTINGS
#define WOLFSSL_USER_SETTINGS
#endif

/* ==========================================================================
 * PQC Configuration - Adjust based on your requirements
 * ========================================================================== */

/* Enable Post-Quantum ML-KEM (Kyber) support */
/* Uncomment to enable PQC key exchange */
// #define ENABLE_MLKEM

/* ML-KEM Security Level: 1=512, 3=768 (recommended), 5=1024 */
#define MLKEM_LEVEL 3

/* Enable Hybrid Key Exchange (ECC + ML-KEM) for transition security */
/* Recommended for production - protects against both classical and quantum attacks */
// #define ENABLE_HYBRID_KEM

/* ==========================================================================
 * Platform Configuration
 * ========================================================================== */

#ifndef WOLFSSL_ZEPHYR
#define WOLFSSL_ZEPHYR
#endif

/* Prevent wolfSSL from redefining min/max - Zephyr already defines them */
#define WOLFSSL_HAVE_MIN
#define WOLFSSL_HAVE_MAX

/* File system and I/O */
#define NO_STDIO_FILESYSTEM
#define NO_WRITEV
#define NO_DEV_RANDOM
#define HAVE_CUSTOM_RNG
#define NO_MAIN_DRIVER

/* Disable BIO file operations */
#define NO_BIO
#define WOLFSSL_NO_STDIO
#define NO_PWDBASED

/* Disable logging to files */
#define NO_ERROR_QUEUE
#define WOLFSSL_NO_STDIO_PRINTF

/* ==========================================================================
 * TLS/DTLS Configuration
 * ========================================================================== */

/* DTLS configuration */
#define WOLFSSL_DTLS
#define HAVE_SOCKADDR

#ifdef ENABLE_MLKEM
    /* ML-KEM requires TLS 1.3 / DTLS 1.3 */
    #define WOLFSSL_TLS13
    #define WOLFSSL_DTLS13
    #define HAVE_TLS13_KEYEXCHANGE
    #define HAVE_HKDF
#endif

/* TLS configuration */
#undef NO_TLS
#undef NO_WOLFSSL_CLIENT
#undef NO_WOLFSSL_SERVER

/* wolfSSL features for libcoap */
#define HAVE_TLS_EXTENSIONS
#define HAVE_SUPPORTED_CURVES
#define HAVE_SNI
#define HAVE_EXTENDED_MASTER

/* ==========================================================================
 * Post-Quantum Cryptography (ML-KEM / Kyber)
 * ========================================================================== */

#ifdef ENABLE_MLKEM
    /* Enable wolfSSL native ML-KEM implementation (no liboqs needed) */
    #define WOLFSSL_HAVE_MLKEM
    #define WOLFSSL_WC_MLKEM
    
    /* Required hash algorithms for ML-KEM */
    #define WOLFSSL_SHA3
    #define WOLFSSL_SHAKE128
    #define WOLFSSL_SHAKE256
    
    /* Enable experimental features */
    #define WOLFSSL_EXPERIMENTAL_SETTINGS
    
    /* Select ML-KEM parameter set based on security level */
    #if MLKEM_LEVEL == 1
        /* ML-KEM-512: NIST Level 1 (~AES-128) - Smallest, fastest */
        #define WOLFSSL_NO_ML_KEM_768
        #define WOLFSSL_NO_ML_KEM_1024
    #elif MLKEM_LEVEL == 3
        /* ML-KEM-768: NIST Level 3 (~AES-192) - Recommended balance */
        #define WOLFSSL_NO_ML_KEM_512
        #define WOLFSSL_NO_ML_KEM_1024
    #elif MLKEM_LEVEL == 5
        /* ML-KEM-1024: NIST Level 5 (~AES-256) - Highest security */
        #define WOLFSSL_NO_ML_KEM_512
        #define WOLFSSL_NO_ML_KEM_768
    #else
        #error "Invalid MLKEM_LEVEL: must be 1, 3, or 5"
    #endif
    
    /* Note: Actual key share selection is done in application code using:
     * wolfSSL_UseKeyShare(ssl, WOLFSSL_ML_KEM_768);
     * or for hybrid:
     * wolfSSL_UseKeyShare(ssl, WOLFSSL_P384_ML_KEM_768);
     */
#endif

/* ==========================================================================
 * Session Management
 * ========================================================================== */

#define SMALL_SESSION_CACHE

/* ==========================================================================
 * Certificate and X.509 Support
 * ========================================================================== */

#undef NO_CERTS
#define WOLFSSL_CERT_VERIFY
#define WOLFSSL_CERT_GEN
#define KEEP_PEER_CERT

/* ASN.1 support */
#define WOLFSSL_ASN_TEMPLATE

/* Buffer-based certificate loading */
#define WOLFSSL_DER_LOAD
#define WOLFSSL_PEM_TO_DER

/* Error handling */
#undef NO_ERROR_STRINGS
#define WOLFSSL_ERROR_CODE_OPENSSL

/* ==========================================================================
 * OpenSSL Compatibility Layer
 * ========================================================================== */

#define OPENSSL_EXTRA
#define OPENSSL_ALL
#define WOLFSSL_CERT_EXT
#define WOLFSSL_MULTI_INSTALL_DIR

#define WOLFSSL_HMAC
#define HAVE_HMAC
#define WOLFSSL_KEY_GEN
#define WOLFSSL_CERT_REQ
#define WOLFSSL_ALT_NAMES
#define HAVE_OID_ENCODING
#define WOLFSSL_CERT_NAME_ALL

/* RSA functionality */
#define OPENSSL_EXTRA_X509_SMALL
#define WOLFSSL_CERT_GEN_CACHE

/* X.509 and certificate verification */
#define WOLFSSL_X509_NAME_AVAILABLE
#define HAVE_CRL
#define WOLFSSL_CRL_ALLOW_MISSING_CDP

/* Callback support */
#define HAVE_EX_DATA

/* ==========================================================================
 * Cryptographic Algorithms
 * ========================================================================== */

/* Hash algorithms */
#define WOLFSSL_SHA256
#define WOLFSSL_SHA384
#define WOLFSSL_SHA512
#define HAVE_HKDF

/* ECC - Required for hybrid key exchange */
#define HAVE_ECC
#define ECC_TIMING_RESISTANT
#define HAVE_ECC_VERIFY
#define HAVE_ECC_SIGN

#ifdef ENABLE_HYBRID_KEM
    /* Enable specific curves for hybrid key exchange */
    #define HAVE_ECC256     /* P-256 for P256_ML_KEM_512 */
    #define HAVE_ECC384     /* P-384 for P384_ML_KEM_768 */
    #define HAVE_ECC521     /* P-521 for P521_ML_KEM_1024 */
#endif

/* AES */
#define HAVE_AES
#define HAVE_AES_CBC
#define HAVE_AESGCM
#define WOLFSSL_AES_128
#define WOLFSSL_AES_256

/* RSA */
#undef NO_RSA
#define WC_RSA_BLINDING
#define WOLFSSL_KEY_GEN
#define WOLFSSL_RSA_KEY_CHECK
#define WOLFSSL_RSA_VERIFY_INLINE

/* DER conversion */
#define WOLFSSL_DER_TO_PEM
#define HAVE_PKCS8

/* Full RSA support */
#define WOLFSSL_RSA_GENERATE_EXTRA

/* HMAC */
#undef NO_HMAC

/* DH */
#undef NO_DH
#define WOLFSSL_DH_CONST

/* Random number generation */
#define HAVE_HASHDRBG
#define WC_RNG_SEED_CB

/* ==========================================================================
 * Memory and Stack Optimization
 * ========================================================================== */

#define WOLFSSL_SMALL_STACK
#define NO_BENCH
#define WOLFSSL_NO_BENCH

/* 
 * IMPORTANT: ML-KEM requires larger stack sizes!
 * Ensure prj.conf has at least:
 *   CONFIG_MAIN_STACK_SIZE=16384
 *   CONFIG_HEAP_MEM_POOL_SIZE=65536
 */

/* ==========================================================================
 * Disabled Features
 * ========================================================================== */

#define NO_DSA
#define NO_RC4
#define NO_MD4
#define NO_MD5
#define NO_OLD_TLS

/* ==========================================================================
 * Math Library
 * ========================================================================== */

#define WOLFSSL_SP_MATH
#define WOLFSSL_SP_SMALL
#define WOLFSSL_HAVE_SP_ECC
#define WOLFSSL_HAVE_SP_RSA

/* ==========================================================================
 * Threading
 * ========================================================================== */

#define SINGLE_THREADED

/* ==========================================================================
 * Debugging
 * ========================================================================== */

#ifdef CONFIG_WOLFSSL_DEBUG
    #ifndef DEBUG_WOLFSSL
        #define DEBUG_WOLFSSL
    #endif
    #undef NO_ERROR_STRINGS
#else
    #undef DEBUG_WOLFSSL
    #define NO_ERROR_STRINGS
#endif

#ifdef __cplusplus
}
#endif

#endif /* WOLFSSL_SETTINGS_H */
```

## include/config-wolfssl-libcoap.h
```c
/*
 * config-wolfssl-libcoap.h
 * wolfSSL configuration for libcoap ESP32 client
 * 
 * Copyright (C) 2024-2025 Javier Blanco-Romero @fj-blanco (UC3M, QURSA project)
 */

#ifndef WOLFSSL_SETTINGS_H
#define WOLFSSL_SETTINGS_H

#ifdef __cplusplus
extern "C" {
#endif

#ifndef WOLFSSL_USER_SETTINGS
#define WOLFSSL_USER_SETTINGS
#endif

/* Platform specific */
#ifndef WOLFSSL_ZEPHYR
#define WOLFSSL_ZEPHYR
#endif

/* Prevent wolfSSL from redefining min/max - Zephyr already defines them */
#define WOLFSSL_HAVE_MIN
#define WOLFSSL_HAVE_MAX

/* File system and I/O */
#define NO_STDIO_FILESYSTEM
#define NO_WRITEV
#define NO_DEV_RANDOM
#define HAVE_CUSTOM_RNG
#define NO_MAIN_DRIVER

/* Disable BIO file operations that cause the fprintf/vfprintf errors */
#define NO_BIO
#define WOLFSSL_NO_STDIO
#define NO_PWDBASED

/* Disable logging to files - this fixes the fprintf errors */
#define NO_ERROR_QUEUE
#define WOLFSSL_NO_STDIO_PRINTF

/* DTLS configuration */
#define WOLFSSL_DTLS
#define HAVE_SOCKADDR

/* TLS configuration */
#undef NO_TLS
#undef NO_WOLFSSL_CLIENT
#undef NO_WOLFSSL_SERVER

/* wolfSSL features for libcoap */
#define HAVE_TLS_EXTENSIONS
#define HAVE_SUPPORTED_CURVES
#define HAVE_SNI
#define HAVE_EXTENDED_MASTER

/* Session management */
#define SMALL_SESSION_CACHE

/* Certificate and X.509 support */
#undef NO_CERTS
#define WOLFSSL_CERT_VERIFY
#define WOLFSSL_CERT_GEN
#define KEEP_PEER_CERT

/* ASN.1 support */
#define WOLFSSL_ASN_TEMPLATE

/* Buffer-based certificate loading */
#define WOLFSSL_DER_LOAD
#define WOLFSSL_PEM_TO_DER

/* Error handling */
#undef NO_ERROR_STRINGS
#define WOLFSSL_ERROR_CODE_OPENSSL

/* OpenSSL compatibility layer */
#define OPENSSL_EXTRA
#define OPENSSL_ALL
#define WOLFSSL_CERT_EXT
#define WOLFSSL_MULTI_INSTALL_DIR

/* Additional OpenSSL compatibility */
#define WOLFSSL_HMAC
#define HAVE_HMAC
#define WOLFSSL_KEY_GEN
#define WOLFSSL_CERT_REQ
#define WOLFSSL_ALT_NAMES
#define HAVE_OID_ENCODING
#define WOLFSSL_CERT_NAME_ALL

/* RSA functionality */
#define OPENSSL_EXTRA_X509_SMALL
#define WOLFSSL_CERT_EXT
#define WOLFSSL_CERT_GEN_CACHE

/* X.509 and certificate verification */
#define WOLFSSL_X509_NAME_AVAILABLE
#define HAVE_CRL
#define WOLFSSL_CRL_ALLOW_MISSING_CDP

/* Remove the problematic RSA_PUBLIC_ONLY - we need full RSA support for libcoap */
/* #define WOLFSSL_RSA_PUBLIC_ONLY */

/* Callback support */
#define HAVE_EX_DATA

/* Hash algorithms */
#define WOLFSSL_SHA256
#define WOLFSSL_SHA384
#define WOLFSSL_SHA512
#define HAVE_HKDF

/* ECC */
#define HAVE_ECC
#define ECC_TIMING_RESISTANT
#define HAVE_ECC_VERIFY
#define HAVE_ECC_SIGN

/* AES */
#define HAVE_AES
#define HAVE_AES_CBC
#define HAVE_AESGCM
#define WOLFSSL_AES_128
#define WOLFSSL_AES_256

/* RSA */
#undef NO_RSA
#define WC_RSA_BLINDING

/* RSA key functions */
#define WOLFSSL_KEY_GEN
#define WOLFSSL_RSA_KEY_CHECK
#define WOLFSSL_RSA_VERIFY_INLINE

/* DER conversion */
#define WOLFSSL_DER_TO_PEM
#define HAVE_PKCS8

/* Full RSA support */
#define WOLFSSL_RSA_GENERATE_EXTRA

/* HMAC */
#undef NO_HMAC

/* DH */
#undef NO_DH
#define WOLFSSL_DH_CONST

/* Random number generation */
#define HAVE_HASHDRBG
#define WC_RNG_SEED_CB

/* Memory and stack optimization */
#define WOLFSSL_SMALL_STACK
#define NO_BENCH
#define WOLFSSL_NO_BENCH

/* Disabled features */
#define NO_DSA
#define NO_RC4
#define NO_MD4
#define NO_MD5
#define NO_OLD_TLS

/* Math library */
#define WOLFSSL_SP_MATH
#define WOLFSSL_SP_SMALL
#define WOLFSSL_HAVE_SP_ECC
#define WOLFSSL_HAVE_SP_RSA

/* Threading */
#define SINGLE_THREADED

/* Debugging - prevents redefinition warnings */
#ifdef CONFIG_WOLFSSL_DEBUG
    #ifndef DEBUG_WOLFSSL
        #define DEBUG_WOLFSSL
    #endif
    #undef NO_ERROR_STRINGS
#else
    #undef DEBUG_WOLFSSL
    #define NO_ERROR_STRINGS
#endif

#ifdef __cplusplus
}
#endif

#endif /* WOLFSSL_SETTINGS_H */
```

## include/wifi.h
```c
/*
* mbedtls/include/wifi.h
*
* Copyright (C) 2024-2025 Javier Blanco-Romero @fj-blanco (UC3M, QURSA project)
* Author: Javier Blanco-Romero
*
* Wi-Fi management header for CoAP client
*/

#include <zephyr/kernel.h>
#include <zephyr/net/net_if.h>
#include <zephyr/net/wifi_mgmt.h>

extern struct wifi_connect_req_params wifi_params;
void wifi_mgmt_event_handler(struct net_mgmt_event_callback *cb,
                             uint64_t mgmt_event, struct net_if *iface);
int wifi_init(struct device *unused);
int shell_cmd_scan(void);
int wait_for_wifi_connection(void);
int connect_to_wifi(void);
void wifi_disconnect(void);
```

## src/main_pqc.c
```c
/* main_pqc.c - CoAP client with ML-KEM Post-Quantum Key Exchange
 *
 * This example demonstrates using ML-KEM (Kyber) for key exchange
 * in a CoAP over DTLS 1.3 connection.
 *
 * Copyright (C) 2024-2025 Javier Blanco-Romero @fj-blanco (UC3M, QURSA project)
 *
 * Key Exchange Options:
 *   - Pure PQC: WOLFSSL_ML_KEM_512, WOLFSSL_ML_KEM_768, WOLFSSL_ML_KEM_1024
 *   - Hybrid:   WOLFSSL_P256_ML_KEM_512, WOLFSSL_P384_ML_KEM_768, WOLFSSL_P521_ML_KEM_1024
 *
 * To enable ML-KEM in your build:
 *   1. Use config-wolfssl-libcoap-pqc.h with ENABLE_MLKEM defined
 *   2. Use prj_pqc.conf overlay for increased stack/heap
 *   3. Ensure server supports DTLS 1.3 with ML-KEM
 */

#include <stdio.h>
#include <stdlib.h>
#include <string.h>
#include <zephyr/init.h>
#include <zephyr/kernel.h>
#include <zephyr/net/socket.h>
#include <zephyr/posix/unistd.h>
#include <zephyr/sys/slist.h>
#include <coap3/coap.h>
#include "wifi.h"

/* Include wolfSSL headers for ML-KEM configuration */
#ifdef ENABLE_MLKEM
#include <wolfssl/ssl.h>
#include <wolfssl/wolfcrypt/settings.h>
#endif

static int have_response = 0;

#ifndef COAP_SERVER_IP
#define COAP_SERVER_IP "134.102.218.18"
#endif

#ifndef COAP_SERVER_PATH
#define COAP_SERVER_PATH "/hello"
#endif

#ifndef COAP_SERVER_PORT
#define COAP_SERVER_PORT COAPS_DEFAULT_PORT  /* DTLS required for ML-KEM */
#endif

#define COAP_CLIENT_URI "coaps://" COAP_SERVER_IP COAP_SERVER_PATH

/* ==========================================================================
 * ML-KEM Key Exchange Configuration
 * 
 * Choose one of the following based on your security requirements:
 * 
 * Pure Post-Quantum (provides PQC security only):
 *   WOLFSSL_ML_KEM_512   - NIST Level 1, fastest, smallest
 *   WOLFSSL_ML_KEM_768   - NIST Level 3, recommended balance
 *   WOLFSSL_ML_KEM_1024  - NIST Level 5, highest security
 * 
 * Hybrid (provides both classical and PQC security):
 *   WOLFSSL_P256_ML_KEM_512  - P-256 + ML-KEM-512
 *   WOLFSSL_P384_ML_KEM_768  - P-384 + ML-KEM-768, recommended for production
 *   WOLFSSL_P521_ML_KEM_1024 - P-521 + ML-KEM-1024
 * 
 * Hybrid is recommended during the transition period as it provides
 * security against both classical and quantum attackers.
 * ========================================================================== */
#ifndef PQC_KEY_EXCHANGE
#define PQC_KEY_EXCHANGE WOLFSSL_P384_ML_KEM_768  /* Hybrid recommended */
#endif

void cleanup_resources(coap_context_t *ctx, coap_session_t *session,
                       coap_optlist_t *optlist) {
    if (optlist)
        coap_delete_optlist(optlist);
    if (session)
        coap_session_release(session);
    if (ctx)
        coap_free_context(ctx);
    coap_cleanup();
}

int setup_destination_address(coap_address_t *dst, const char *host,
                              uint16_t port) {
    printf("Setting up destination address: %s:%d\n", host, port);

    memset(dst, 0, sizeof(coap_address_t));

    struct sockaddr_in *sin = (struct sockaddr_in *)&dst->addr.sin;
    sin->sin_family = AF_INET;
    sin->sin_port = htons(port);

    if (inet_pton(AF_INET, host, &sin->sin_addr) <= 0) {
        printf("Failed to convert IP address: %s\n", host);
        return 0;
    }

    dst->size = sizeof(struct sockaddr_in);
    dst->addr.sa.sa_family = AF_INET;

    printf("Address configured: %s:%d\n", host, port);
    return 1;
}

static coap_response_t response_handler(coap_session_t *session,
                                        const coap_pdu_t *sent,
                                        const coap_pdu_t *received,
                                        const int id) {
    size_t len;
    const uint8_t *databuf;
    size_t offset;
    size_t total;

    (void)session;
    (void)sent;
    (void)id;

    have_response = 1;
    printf("\n=== RESPONSE RECEIVED ===\n");
    coap_show_pdu(COAP_LOG_WARN, received);
    if (coap_get_data_large(received, &len, &databuf, &offset, &total)) {
        printf("Response data: ");
        fwrite(databuf, 1, len, stdout);
        printf("\n");
    }
    printf("=== END RESPONSE ===\n");
    return COAP_RESPONSE_OK;
}

void verify_tls_backend(void) {
    printf("\n=== TLS Backend Verification ===\n");
    
    coap_tls_version_t *tls_version = coap_get_tls_library_version();
    
    if (!tls_version) {
        printf("Failed to get TLS library version\n");
        return;
    }
    
    switch (tls_version->type) {
        case COAP_TLS_LIBRARY_WOLFSSL:
            printf("Using wolfSSL backend\n");
            break;
        default:
            printf("TLS backend type: %d\n", tls_version->type);
            break;
    }
    
    printf("DTLS supported: %s\n", coap_dtls_is_supported() ? "Yes" : "No");
    printf("DTLS PKI supported: %s\n", coap_dtls_pki_is_supported() ? "Yes" : "No");
    
#ifdef ENABLE_MLKEM
    printf("ML-KEM (PQC) support: ENABLED\n");
    printf("Configured key exchange: ");
    #if PQC_KEY_EXCHANGE == WOLFSSL_ML_KEM_512
    printf("ML-KEM-512 (NIST Level 1)\n");
    #elif PQC_KEY_EXCHANGE == WOLFSSL_ML_KEM_768
    printf("ML-KEM-768 (NIST Level 3)\n");
    #elif PQC_KEY_EXCHANGE == WOLFSSL_ML_KEM_1024
    printf("ML-KEM-1024 (NIST Level 5)\n");
    #elif PQC_KEY_EXCHANGE == WOLFSSL_P256_ML_KEM_512
    printf("P256_ML_KEM_512 (Hybrid Level 1)\n");
    #elif PQC_KEY_EXCHANGE == WOLFSSL_P384_ML_KEM_768
    printf("P384_ML_KEM_768 (Hybrid Level 3) [RECOMMENDED]\n");
    #elif PQC_KEY_EXCHANGE == WOLFSSL_P521_ML_KEM_1024
    printf("P521_ML_KEM_1024 (Hybrid Level 5)\n");
    #else
    printf("Custom: %d\n", PQC_KEY_EXCHANGE);
    #endif
#else
    printf("ML-KEM (PQC) support: DISABLED\n");
#endif
    
    printf("=== End TLS Backend Verification ===\n\n");
}

/* DTLS PKI setup with ML-KEM key exchange
 * 
 * Note: Certificate type (RSA, ECC, ML-DSA) is independent of key exchange.
 * You can use ML-KEM key exchange with any certificate type.
 */
static coap_dtls_pki_t *setup_pki_with_mlkem(void) {
    static coap_dtls_pki_t dtls_pki;
    
    memset(&dtls_pki, 0, sizeof(dtls_pki));
    dtls_pki.version = COAP_DTLS_PKI_SETUP_VERSION;
    
    /* Disable certificate verification for testing
     * In production, set to 1 and provide proper CA certificate */
    dtls_pki.verify_peer_cert = 0;
    dtls_pki.is_rpk_not_cert = 0;
    
    /* For production with ML-DSA certificates, you would set:
     * dtls_pki.pki_key.key_type = COAP_PKI_KEY_PEM;
     * dtls_pki.pki_key.key.pem.public_cert = "ml_dsa_server_cert.pem";
     * dtls_pki.pki_key.key.pem.private_key = "ml_dsa_server_key.pem";
     * dtls_pki.pki_key.key.pem.ca_file = "ml_dsa_ca_cert.pem";
     */
    
    return &dtls_pki;
}

#ifdef ENABLE_MLKEM
/* Callback to configure ML-KEM key exchange on the DTLS session
 * 
 * This is called by libcoap/wolfSSL during session setup.
 * It sets the preferred key exchange algorithm.
 */
static void configure_mlkem_keyshare(WOLFSSL *ssl) {
    if (ssl == NULL) {
        printf("ERROR: SSL context is NULL\n");
        return;
    }
    
    printf("Configuring ML-KEM key exchange...\n");
    
    /* Set the ML-KEM key share */
    int ret = wolfSSL_UseKeyShare(ssl, PQC_KEY_EXCHANGE);
    
    if (ret == WOLFSSL_SUCCESS) {
        printf("ML-KEM key exchange configured successfully\n");
    } else {
        printf("WARNING: Failed to set ML-KEM key share (error: %d)\n", ret);
        printf("Falling back to default key exchange\n");
    }
}
#endif

int main(void) {
    coap_context_t *ctx = NULL;
    coap_session_t *session = NULL;
    coap_optlist_t *optlist = NULL;
    coap_address_t dst;
    coap_pdu_t *pdu = NULL;
    int result = EXIT_FAILURE;
    int len;
    int res;
    unsigned int wait_ms;
    coap_uri_t uri;
    const char *coap_uri = COAP_CLIENT_URI;
#define BUFSIZE 100
    unsigned char scratch[BUFSIZE];

    printf("\n");
    printf("============================================\n");
    printf(" CoAP Client with Post-Quantum Cryptography\n");
    printf("============================================\n");
    printf("Target URI: %s\n", coap_uri);
    printf("Server Port: %d\n", COAP_SERVER_PORT);
    printf("Protocol: CoAP over DTLS 1.3\n");
    printf("============================================\n\n");

    /* Initialize libcoap library */
    coap_startup();

    /* Verify TLS backend and PQC configuration */
    verify_tls_backend();

    /* Set logging level */
    coap_set_log_level(COAP_LOG_WARN);

    /* Parse the URI */
    len = coap_split_uri((const unsigned char *)coap_uri, strlen(coap_uri), &uri);
    if (len != 0) {
        coap_log_warn("Failed to parse uri %s\n", coap_uri);
        goto finish;
    }
    printf("URI parsed successfully\n");

    /* Connect to WiFi */
    wifi_init(NULL);
    
    int wifi_connected = 0;
    for (int attempt = 1; attempt <= 3 && !wifi_connected; attempt++) {
        if (attempt > 1) {
            printf("WiFi retry attempt %d/3...\n", attempt);
        }
        
        int ret = connect_to_wifi();
        if (ret >= 0 && wait_for_wifi_connection() >= 0) {
            wifi_connected = 1;
        } else {
            printf("WiFi connection attempt %d failed\n", attempt);
            if (attempt < 3) {
                wifi_disconnect();
                k_sleep(K_MSEC(2000));
            }
        }
    }

    if (!wifi_connected) {
        printf("Failed to connect to WiFi after 3 attempts\n");
        goto finish;
    }

    k_sleep(K_MSEC(1000));

    /* Setup destination address */
    char host_str[64];
    if (uri.host.length < sizeof(host_str)) {
        memcpy(host_str, uri.host.s, uri.host.length);
        host_str[uri.host.length] = '\0';
    } else {
        printf("Host string too long\n");
        goto finish;
    }

    uint16_t port = uri.port ? uri.port : COAP_SERVER_PORT;
    if (!setup_destination_address(&dst, host_str, port)) {
        printf("Failed to setup destination address\n");
        goto finish;
    }

    /* Create CoAP context */
    printf("Creating CoAP context...\n");
    if (!(ctx = coap_new_context(NULL))) {
        coap_log_emerg("Cannot create libcoap context\n");
        goto finish;
    }

    coap_context_set_block_mode(ctx, COAP_BLOCK_USE_LIBCOAP |
                                     COAP_BLOCK_SINGLE_BODY);

    /* Create DTLS session with ML-KEM
     * 
     * Key exchange (ML-KEM) is negotiated during the TLS handshake.
     * The certificate type (RSA, ECC, ML-DSA) is separate from key exchange.
     */
    if (uri.scheme == COAP_URI_SCHEME_COAPS) {
        printf("Creating DTLS session with PQC key exchange...\n");
        
        coap_dtls_pki_t *dtls_pki = setup_pki_with_mlkem();
        session = coap_new_client_session_pki(ctx, NULL, &dst, 
                                               COAP_PROTO_DTLS, dtls_pki);
        
#ifdef ENABLE_MLKEM
        if (session) {
            /* Get the underlying wolfSSL object and configure ML-KEM
             * 
             * Note: In current libcoap, this might need to be done via
             * a custom setup callback or by modifying libcoap's wolfSSL
             * integration. This example shows the concept.
             */
            /* TODO: libcoap integration for key share selection
             * 
             * Option 1: Use environment variable COAP_WOLFSSL_GROUPS
             *   - Set before starting: export COAP_WOLFSSL_GROUPS=P384_KYBER_LEVEL3
             *   - This is the easiest approach with patched libcoap
             * 
             * Option 2: Direct wolfSSL access (requires libcoap modification)
             *   - Get WOLFSSL* from session
             *   - Call wolfSSL_UseKeyShare(ssl, PQC_KEY_EXCHANGE)
             * 
             * Option 3: Build libcoap with compile-time default
             *   - Use CPPFLAGS="-DCOAP_WOLFSSL_GROUPS=..."
             */
            printf("ML-KEM key exchange will be negotiated during handshake\n");
        }
#endif
    } else {
        /* Non-DTLS session (not recommended for PQC) */
        session = coap_new_client_session(ctx, NULL, &dst, COAP_PROTO_UDP);
    }

    if (!session) {
        coap_log_emerg("Cannot create client session\n");
        goto finish;
    }
    printf("Session created successfully\n");

    coap_register_response_handler(ctx, response_handler);

    /* Construct CoAP message */
    pdu = coap_pdu_init(COAP_MESSAGE_CON, COAP_REQUEST_CODE_GET,
                        coap_new_message_id(session),
                        coap_session_max_pdu_size(session));
    if (!pdu) {
        coap_log_emerg("Cannot create PDU\n");
        goto finish;
    }

    len = coap_uri_into_options(&uri, &dst, &optlist, 1, scratch, sizeof(scratch));
    if (len) {
        coap_log_warn("Failed to create options\n");
        goto finish;
    }

    if (optlist) {
        res = coap_add_optlist_pdu(pdu, &optlist);
        if (res != 1) {
            coap_log_warn("Failed to add options to PDU\n");
            goto finish;
        }
    }

    coap_show_pdu(COAP_LOG_WARN, pdu);

    /* Send the request */
    printf("Sending CoAP request (ML-KEM handshake will occur)...\n");
    if (coap_send(session, pdu) == COAP_INVALID_MID) {
        coap_log_err("Cannot send CoAP PDU\n");
        goto finish;
    }
    printf("Request sent successfully\n");

    wait_ms = (coap_session_get_default_leisure(session).integer_part + 1) * 1000;

    printf("Waiting for response...\n");
    while (have_response == 0) {
        res = coap_io_process(ctx, 500);
        if (res >= 0) {
            if (wait_ms > 0) {
                if ((unsigned)res >= wait_ms) {
                    printf("TIMEOUT: No response received\n");
                    break;
                } else {
                    wait_ms -= res;
                }
            }
        }
    }

    if (have_response != 0) {
        printf("\n=== SUCCESS ===\n");
        printf("CoAP response received over DTLS 1.3\n");
#ifdef ENABLE_MLKEM
        printf("Key exchange: ML-KEM (Post-Quantum)\n");
#endif
        printf("===============\n");
        result = EXIT_SUCCESS;
    } else {
        printf("FAILED: No response received\n");
    }

finish:
    printf("Cleaning up resources...\n");
    cleanup_resources(ctx, session, optlist);
    wifi_disconnect();
    printf("CLIENT FINISHED.\n");

    return result;
}
```
